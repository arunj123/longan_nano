#pragma once
#include <cstdint>
#include <cstddef>
#include <array>
#include <string_view>

namespace lcd {
namespace font {

enum class GlyphLayout : uint8_t {
    ColumnMajorLsb, // 1 byte per column (bit 0 = top row). Used by Font5x7.
    RowMajorLsb,    // 1 byte per row (bit 0 = left col). Used by Font8x16.
    RowMajorMsb,    // 1 byte per row (bit 7 = left col). Used by Font16x24.
};

// Structural type for string literal NTTP (C++20/C++23)
template <size_t N>
struct FixedString {
    char buf[N]{};
    constexpr FixedString(const char (&str)[N]) {
        for (size_t i = 0; i < N; ++i) buf[i] = str[i];
    }
    constexpr size_t size() const noexcept { return N > 0 ? N - 1 : 0; }
    constexpr char operator[](size_t i) const noexcept { return buf[i]; }
};

// Compile-time helpers to collect unique sorted characters from a string
template <FixedString Str>
consteval size_t count_unique_chars() {
    size_t count = 0;
    for (size_t i = 0; i < Str.size(); ++i) {
        char c = Str[i];
        bool seen = false;
        for (size_t j = 0; j < i; ++j) {
            if (Str[j] == c) { seen = true; break; }
        }
        if (!seen) ++count;
    }
    return count;
}

template <FixedString Str>
consteval auto get_unique_chars() {
    constexpr size_t K = count_unique_chars<Str>();
    std::array<char, K> result{};
    size_t idx = 0;
    for (size_t i = 0; i < Str.size(); ++i) {
        char c = Str[i];
        bool seen = false;
        for (size_t j = 0; j < i; ++j) {
            if (Str[j] == c) { seen = true; break; }
        }
        if (!seen) {
            result[idx++] = c;
        }
    }
    for (size_t i = 0; i < K; ++i) {
        for (size_t j = i + 1; j < K; ++j) {
            if (result[i] > result[j]) {
                char t = result[i]; result[i] = result[j]; result[j] = t;
            }
        }
    }
    return result;
}

// -----------------------------------------------------------------------------
// SubsetFont: Compile-Time Character Subset Generator
// -----------------------------------------------------------------------------
template <typename BaseFont, FixedString Chars>
class SubsetFont {
public:
    static constexpr size_t char_count = count_unique_chars<Chars>();
    static constexpr uint8_t width = BaseFont::width;
    static constexpr uint8_t height = BaseFont::height;
    static constexpr uint8_t spacing = BaseFont::spacing;
    static constexpr GlyphLayout layout = BaseFont::layout;
    static constexpr size_t bytes_per_glyph = BaseFont::bytes_per_glyph;

    struct Table {
        std::array<char, char_count> chars;
        std::array<uint8_t, char_count * bytes_per_glyph> data;
    };

    static consteval Table build_table() {
        Table t{};
        t.chars = get_unique_chars<Chars>();
        for (size_t i = 0; i < char_count; ++i) {
            char c = t.chars[i];
            const uint8_t* g = BaseFont::glyph(c);
            for (size_t b = 0; b < bytes_per_glyph; ++b) {
                t.data[i * bytes_per_glyph + b] = (g ? g[b] : 0);
            }
        }
        return t;
    }

    static constexpr Table table = build_table();

    static constexpr const uint8_t* glyph(char c) noexcept {
        int low = 0;
        int high = static_cast<int>(char_count) - 1;
        while (low <= high) {
            int mid = low + (high - low) / 2;
            auto umid = static_cast<size_t>(mid);
            if (table.chars[umid] == c) {
                return &table.data[umid * bytes_per_glyph];
            }
            if (table.chars[umid] < c) {
                low = mid + 1;
            } else {
                high = mid - 1;
            }
        }
        return nullptr;
    }

    static constexpr bool is_pixel_set(const uint8_t* g, uint8_t px, uint8_t py) noexcept {
        return BaseFont::is_pixel_set(g, px, py);
    }
};

// -----------------------------------------------------------------------------
// RangeFont: Contiguous Range Subset (Zero-overhead O(1) index)
// -----------------------------------------------------------------------------
template <typename BaseFont, char StartChar, char EndChar>
class RangeFont {
    static_assert(StartChar <= EndChar);
public:
    static constexpr size_t char_count = static_cast<size_t>(EndChar - StartChar + 1);
    static constexpr uint8_t width = BaseFont::width;
    static constexpr uint8_t height = BaseFont::height;
    static constexpr uint8_t spacing = BaseFont::spacing;
    static constexpr GlyphLayout layout = BaseFont::layout;
    static constexpr size_t bytes_per_glyph = BaseFont::bytes_per_glyph;

    static consteval auto build_table() {
        std::array<uint8_t, char_count * bytes_per_glyph> data{};
        for (size_t i = 0; i < char_count; ++i) {
            char c = static_cast<char>(StartChar + i);
            const uint8_t* g = BaseFont::glyph(c);
            for (size_t b = 0; b < bytes_per_glyph; ++b) {
                data[i * bytes_per_glyph + b] = (g ? g[b] : 0);
            }
        }
        return data;
    }

    static constexpr auto table = build_table();

    static constexpr const uint8_t* glyph(char c) noexcept {
        if (c < StartChar || c > EndChar) return nullptr;
        return &table[(c - StartChar) * bytes_per_glyph];
    }

    static constexpr bool is_pixel_set(const uint8_t* g, uint8_t px, uint8_t py) noexcept {
        return BaseFont::is_pixel_set(g, px, py);
    }
};

// -----------------------------------------------------------------------------
// Font5x7: Standard 5x7 ASCII Bitmap Font (ASCII 32..126)
// -----------------------------------------------------------------------------
struct Font5x7 {
    static constexpr uint8_t width = 5;
    static constexpr uint8_t height = 7;
    static constexpr uint8_t spacing = 1;
    static constexpr GlyphLayout layout = GlyphLayout::ColumnMajorLsb;
    static constexpr size_t bytes_per_glyph = 5;
    static constexpr char first_char = 32;
    static constexpr char last_char = 126;
    static constexpr size_t total_chars = 95;

    static constexpr uint8_t raw_table[95 * 5] = {
        0x00, 0x00, 0x00, 0x00, 0x00, 0x00, 0x00, 0x5F, 0x00, 0x00, 0x00, 0x07, 0x00, 0x07, 0x00,
        0x14, 0x7F, 0x14, 0x7F, 0x14, 0x24, 0x2A, 0x7F, 0x2A, 0x12, 0x23, 0x13, 0x08, 0x64, 0x62,
        0x36, 0x49, 0x55, 0x22, 0x50, 0x00, 0x05, 0x03, 0x00, 0x00, 0x00, 0x1C, 0x22, 0x41, 0x00,
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        0x00, 0x41, 0x36, 0x08, 0x00, 0x10, 0x08, 0x08, 0x10, 0x08,
    };

    static constexpr const uint8_t* glyph(char c) noexcept {
        if (c < first_char || c > last_char) return nullptr;
        return &raw_table[(c - first_char) * bytes_per_glyph];
    }

    static constexpr bool is_pixel_set(const uint8_t* g, uint8_t px, uint8_t py) noexcept {
        if (!g) return false;
        return (g[px] & (1U << py)) != 0;
    }
};

// -----------------------------------------------------------------------------
// Font8x16: Classic 8x16 Terminal/OLED Bitmap Font (ASCII 32..126)
// -----------------------------------------------------------------------------
struct Font8x16 {
    static constexpr uint8_t width = 8;
    static constexpr uint8_t height = 16;
    static constexpr uint8_t spacing = 0;
    static constexpr GlyphLayout layout = GlyphLayout::RowMajorLsb;
    static constexpr size_t bytes_per_glyph = 16;
    static constexpr char first_char = 32;
    static constexpr char last_char = 126;
    static constexpr size_t total_chars = 95;

    static constexpr uint8_t raw_table[95 * 16] = {
        0x00, 0x00, 0x00, 0x00, 0x00, 0x00, 0x00, 0x00, 0x00, 0x00, 0x00, 0x00, 0x00, 0x00, 0x00, 0x00,
        0x00, 0x00, 0x00, 0x08, 0x08, 0x08, 0x08, 0x08, 0x08, 0x08, 0x00, 0x00, 0x18, 0x18, 0x00, 0x00,
        0x00, 0x48, 0x6C, 0x24, 0x12, 0x00, 0x00, 0x00, 0x00, 0x00, 0x00, 0x00, 0x00, 0x00, 0x00, 0x00,
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        0x0C, 0x32, 0xC2, 0x00, 0x00, 0x00, 0x00, 0x00, 0x00, 0x00, 0x00, 0x00, 0x00, 0x00, 0x00, 0x00,
    };

    static constexpr const uint8_t* glyph(char c) noexcept {
        if (c < first_char || c > last_char) return nullptr;
        return &raw_table[(c - first_char) * bytes_per_glyph];
    }

    static constexpr bool is_pixel_set(const uint8_t* g, uint8_t px, uint8_t py) noexcept {
        if (!g) return false;
        return (g[py] & (1U << px)) != 0;
    }
};

// -----------------------------------------------------------------------------
// Font16x24: Large Bold 16x24 Font for Numbers, Temperature & Sensor Units
// Supports: ' ', '%', '*', '+', '-', '.', '/', '0'..'9', ':', 'A', 'C', 'F', 'V', 'W', 'm'
// Note: '*' is rendered as a clean degree symbol ('°') for temperatures!
// -----------------------------------------------------------------------------
struct Font16x24 {
    static constexpr uint8_t width = 16;
    static constexpr uint8_t height = 24;
    static constexpr uint8_t spacing = 1;
    static constexpr GlyphLayout layout = GlyphLayout::RowMajorMsb;
    static constexpr size_t bytes_per_glyph = 48;
    static constexpr size_t char_count = 24;

    static constexpr char char_list[char_count] = {
        ' ', '%', '*', '+', '-', '.', '/', '0', '1', '2', '3', '4', '5', '6', '7', '8', '9', ':', 'A', 'C', 'F', 'V', 'W', 'm'
    };

    static constexpr uint8_t raw_table[char_count * 48] = {
        0x00, 0x00, 0x00, 0x00, 0x00, 0x00, 0x00, 0x00, 0x00, 0x00, 0x00, 0x00, 0x00, 0x00, 0x00, 0x00,
        0x00, 0x00, 0x00, 0x00, 0x00, 0x00, 0x00, 0x00, 0x00, 0x00, 0x00, 0x00, 0x00, 0x00, 0x00, 0x00,
        0x00, 0x00, 0x00, 0x00, 0x00, 0x00, 0x00, 0x00, 0x00, 0x00, 0x00, 0x00, 0x00, 0x00, 0x00, 0x00,
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        0x71, 0xC3, 0x71, 0xC3, 0x71, 0xC3, 0x71, 0xC3, 0x00, 0x00, 0x00, 0x00, 0x00, 0x00, 0x00, 0x00,
    };

    static constexpr const uint8_t* glyph(char c) noexcept {
        for (size_t i = 0; i < char_count; ++i) {
            if (char_list[i] == c) return &raw_table[i * bytes_per_glyph];
        }
        return nullptr;
    }

    static constexpr bool is_pixel_set(const uint8_t* g, uint8_t px, uint8_t py) noexcept {
        if (!g) return false;
        size_t byte_idx = static_cast<size_t>(py) * 2U + (static_cast<size_t>(px) / 8U);
        uint8_t bit_idx = static_cast<uint8_t>(7U - (px % 8U));
        return (g[byte_idx] & (1U << bit_idx)) != 0;
    }
};

// Specialized convenience aliases
template <typename BaseFont = Font5x7>
using NumericFont = RangeFont<BaseFont, '0', '9'>;

template <FixedString Chars, typename BaseFont = Font5x7>
using SubsetFontT = SubsetFont<BaseFont, Chars>;

template <typename BaseFont, FixedString Chars>
consteval auto make_subset() {
    return SubsetFont<BaseFont, Chars>{};
}

} // namespace font
} // namespace lcd
