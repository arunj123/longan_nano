#include "font.h"
#include "lcd.h"

// 8x16 font data
extern uint16_t g_fb[LCD_FRAMEBUFFER_PIXELS];

static const unsigned char font[256][16] = {
    {0x00, 0x00, 0x00, 0x00, 0x00, 0x00, 0x00, 0x00, 0x00, 0x00, 0x00, 0x00, 0x00, 0x00, 0x00, 0x00}, // 0x00
    {0x00, 0x00, 0x00, 0x00, 0x00, 0x00, 0x00, 0x00, 0x00, 0x00, 0x00, 0x00, 0x00, 0x00, 0x00, 0x00}, // 0x01
    {0x00, 0x00, 0x00, 0x00, 0x00, 0x00, 0x00, 0x00, 0x00, 0x00, 0x00, 0x00, 0x00, 0x00, 0x00, 0x00}, // 0x02
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    {0x76, 0xDC, 0x00, 0x00, 0x00, 0x00, 0x00, 0x00, 0x00, 0x00, 0x00, 0x00, 0x00, 0x00, 0x00, 0x00}, // '~'
};

void draw_char(int x, int y, char c, uint16_t color) {
    if (x < 0 || x + 8 > LCD_WIDTH || y < 0 || y + 16 > LCD_HEIGHT) {
        return;
    }

    const unsigned char *glyph = font[(unsigned char)c];

    for (int i = 0; i < 16; i++) {
        for (int j = 0; j < 8; j++) {
            if ((glyph[i] >> (7 - j)) & 1) {
                g_fb[(y + i) * LCD_WIDTH + (x + j)] = color;
            }
        }
    }
}

void draw_string(int x, int y, const char* str, uint16_t color) {
    while (*str) {
        draw_char(x, y, *str, color);
        x += 8;
        if (x + 8 > LCD_WIDTH) {
            x = 0;
            y += 16;
        }
        str++;
    }
}